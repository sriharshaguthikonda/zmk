## app/boards/adafruit_kb2040.conf
```kconfig
CONFIG_CONSOLE=n
CONFIG_SERIAL=n
CONFIG_UART_CONSOLE=n
CONFIG_ZMK_USB=y
#CONFIG_ZMK_HID_CONSUMER_REPORT_USAGES_FULL=y


# encoder
CONFIG_EC11=y
CONFIG_EC11_TRIGGER_GLOBAL_THREAD=y
```
